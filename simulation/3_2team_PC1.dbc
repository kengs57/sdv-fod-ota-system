VERSION ""

NS_ :

BS_:

BU_: OderPanelECU Gateway TCU

BO_ 1072 msg_list_ready: 1 TCU
 SG_ data_file_ready_flag : 0|1@0+ (1,0) [0|1] ""  OderPanelECU

BO_ 1056 msg_list_refresh: 1 OderPanelECU
 SG_ purchase_list_refresh_req : 0|1@1+ (1,0) [0|1] ""  TCU

BO_ 1040 msg_order_state: 2 TCU
 SG_ confirmed_feature_id : 15|8@0+ (1,0) [0|255] ""  OderPanelECU
 SG_ order_status_result : 2|3@0+ (1,0) [0|7] ""  OderPanelECU

BO_ 1024 msg_order_request: 2 OderPanelECU
 SG_ selected_feature_id : 7|8@0+ (1,0) [0|255] ""  TCU
 SG_ purchase_trigger : 8|1@0+ (1,0) [0|1] ""  TCU

EV_ EnvKlemme30: 0 [0|1] "" 1 1 DUMMY_NODE_VECTOR0 Vector__XXX;

EV_ EnvKlemme15: 0 [0|1] "" 0 2 DUMMY_NODE_VECTOR0 Vector__XXX;

BA_DEF_ BU_  "NodeLayerModules" STRING ;
BA_DEF_ BO_  "GenMsgILSupport" ENUM  "No","Yes";
BA_DEF_  "NmBaseAddress" HEX 1024 1087;
BA_DEF_ BO_  "GenMsgSendType" ENUM  "Cyclic","NotUsed","NotUsed","NotUsed","NotUsed","NotUsed","NotUsed","IfActive","NoMsgSendType","NotUsed","vector_leerstring";
BA_DEF_ SG_  "GenSigSendType" ENUM  "Cyclic","OnWrite","OnWriteWithRepetition","OnChange","OnChangeWithRepetition","IfActive","IfActiveWithRepetition","NoSigSendType","NotUsed","NotUsed","NotUsed","NotUsed","NotUsed";
BA_DEF_DEF_  "NodeLayerModules" "CANoeILNLVector.dll";
BA_DEF_DEF_  "GenMsgILSupport" "Yes";
BA_DEF_DEF_  "NmBaseAddress" 1024;
BA_DEF_DEF_  "GenMsgSendType" "NoMsgSendType";
BA_DEF_DEF_  "GenSigSendType" "Cyclic";
